## app/boards/fenix/fxa500_02/board.yml
```yaml
board:
  name: fxa500_02
  vendor: fenix
  socs:
    - name: m2354
    #- name: esp32c6-mini
  # revision:
  #   format: <major.minor.patch|letter|number|custom>
  #   default: <default-revision-value>
  #   exact: <true|false>
  #   revisions:
  #   - name: <revA>
  #   - name: <revB>
```

## app/boards/fenix/fxa500_02/fxa500_02_defconfig
```kconfig
# SPDX-License-Identifier: Apache-2.0

CONFIG_SOC_SERIES_M2354=y
CONFIG_SOC_M2354=y
CONFIG_PINCTRL=y
CONFIG_GPIO=y

# Enable system clock controller driver
CONFIG_CLOCK_CONTROL=y
CONFIG_CLOCK_CONTROL_NUMAKER2_SCC=y

# Enable MPU
CONFIG_ARM_MPU=y
# CONFIG_SYS_CLOCK_HW_CYCLES_PER_SEC=96000000
# CONFIG_SYS_CLOCK_HW_CYCLES_PER_SEC=12000000

# enable uart driver
CONFIG_SERIAL=y
CONFIG_UART_INTERRUPT_DRIVEN=y
# CONFIG_UART_INTERRUPT_DRIVEN=n

# console
CONFIG_CONSOLE=y
CONFIG_UART_CONSOLE=y

# Enable FMC
#CONFIG_FLASH=y
#CONFIG_SOC_FLASH_NUMAKER2=y
```

## app/boards/fenix/fxa500_03/Kconfig.defconfig
```kconfig
# SPDX-License-Identifier: Apache-2.0
#
# Copyright (c) 2024 BaDen (baden.i.ua@gmail.com)

if BOARD_FXA500_03

config BOARD
	default "fxa500_03"
endif
```

## app/boards/fenix/fxa500_03/Kconfig.fxa500_03
```kconfig
# SPDX-License-Identifier: Apache-2.0
#
# Copyright (c) 2024 BaDen (baden.i.ua@gmail.com)

config BOARD_FXA500_03
	#bool "Fenix Auto FXA500-03 Board"
	#depends on SOC_M2354
	select SOC_STM32H563XX
```

## app/boards/fenix/fxa500_03/board.yml
```yaml
board:
  name: fxa500_03
  vendor: fenix
  socs:
    - name: stm32h563xx
    #- name: esp32c6-mini
  # revision:
  #   format: <major.minor.patch|letter|number|custom>
  #   default: <default-revision-value>
  #   exact: <true|false>
  #   revisions:
  #   - name: <revA>
  #   - name: <revB>
```

## app/build/Kconfig/Kconfig.modules
```kconfig
config ZEPHYR_APP_MODULE
	bool
	default y
menu "m2354 (C:/Users/GameON/sdk/fenix-fx500-hello-world/modules/zephyr/soc/nuvoton/m2354)"
osource "C:/Users/GameON/sdk/fenix-fx500-hello-world/modules/zephyr/soc/nuvoton/m2354/Kconfig"
config ZEPHYR_M2354_MODULE
	bool
	default y
endmenu
config ZEPHYR_HAL_NUVOTON_MODULE
	bool
	default y
menu "shock_sensor_drivers (C:/Users/GameON/sdk/fenix-fx500-hello-world/modules/shock-sensor-driver)"
osource "C:/Users/GameON/sdk/fenix-fx500-hello-world/modules/shock-sensor-driver/Kconfig"
config ZEPHYR_SHOCK_SENSOR_DRIVERS_MODULE
	bool
	default y
endmenu
menu "zephyr_accel_sensor (C:/Users/GameON/sdk/fenix-fx500-hello-world/modules/accel-sensor-driver)"
osource "C:/Users/GameON/sdk/fenix-fx500-hello-world/modules/accel-sensor-driver/Kconfig"
config ZEPHYR_ZEPHYR_ACCEL_SENSOR_MODULE
	bool
	default y
endmenu
menu "cmsis (C:/Users/GameON/sdk/fenix-fx500-hello-world/modules/hal/cmsis)"
osource "$(ZEPHYR_CMSIS_KCONFIG)"
config ZEPHYR_CMSIS_MODULE
	bool
	default y
endmenu
menu "hal_wch (C:/Users/GameON/sdk/fenix-fx500-hello-world/modules/hal/wch)"
osource "$(ZEPHYR_HAL_WCH_KCONFIG)"
config ZEPHYR_HAL_WCH_MODULE
	bool
	default y
endmenu
menu "littlefs (C:/Users/GameON/sdk/fenix-fx500-hello-world/modules/fs/littlefs)"
osource "$(ZEPHYR_LITTLEFS_KCONFIG)"
config ZEPHYR_LITTLEFS_MODULE
	bool
	default y
endmenu
```

## app/build/Kconfig/Kconfig.shield
```kconfig
osource "C:/Users/GameON/sdk/fenix-fx500-hello-world/app/boards/shields/*/Kconfig.shield"
```

## app/build/Kconfig/Kconfig.sysbuild.modules
```kconfig
config ZEPHYR_APP_MODULE
   bool
   default y
config ZEPHYR_M2354_MODULE
   bool
   default y
config ZEPHYR_HAL_NUVOTON_MODULE
   bool
   default y
config ZEPHYR_SHOCK_SENSOR_DRIVERS_MODULE
   bool
   default y
config ZEPHYR_ZEPHYR_ACCEL_SENSOR_MODULE
   bool
   default y
config ZEPHYR_CMSIS_MODULE
   bool
   default y
config ZEPHYR_HAL_WCH_MODULE
   bool
   default y
config ZEPHYR_LITTLEFS_MODULE
   bool
   default y
```

## app/build/Kconfig/arch/Kconfig
```kconfig
# Load Zephyr Arch Kconfig descriptions.
osource "C:/Users/GameON/sdk/fenix-fx500-hello-world/zephyr/arch/x86/Kconfig"
osource "C:/Users/GameON/sdk/fenix-fx500-hello-world/zephyr/arch/xtensa/Kconfig"
osource "C:/Users/GameON/sdk/fenix-fx500-hello-world/zephyr/arch/sparc/Kconfig"
osource "C:/Users/GameON/sdk/fenix-fx500-hello-world/zephyr/arch/riscv/Kconfig"
osource "C:/Users/GameON/sdk/fenix-fx500-hello-world/zephyr/arch/posix/Kconfig"
osource "C:/Users/GameON/sdk/fenix-fx500-hello-world/zephyr/arch/nios2/Kconfig"
osource "C:/Users/GameON/sdk/fenix-fx500-hello-world/zephyr/arch/mips/Kconfig"
osource "C:/Users/GameON/sdk/fenix-fx500-hello-world/zephyr/arch/arm64/Kconfig"
osource "C:/Users/GameON/sdk/fenix-fx500-hello-world/zephyr/arch/arm/Kconfig"
osource "C:/Users/GameON/sdk/fenix-fx500-hello-world/zephyr/arch/arc/Kconfig"
```

## app/build/Kconfig/boards/Kconfig.sysbuild
```kconfig
# Load Sysbuild board Kconfig descriptions.
osource "C:/Users/GameON/sdk/fenix-fx500-hello-world/app/boards/fenix/fxa500_02/Kconfig.sysbuild"
```

## app/build/Kconfig/soc/Kconfig.sysbuild
```kconfig
# Load Sysbuild SoC Kconfig descriptions.
osource "C:/Users/GameON/sdk/fenix-fx500-hello-world/zephyr/soc/xlnx/zynqmp/Kconfig.sysbuild"
osource "C:/Users/GameON/sdk/fenix-fx500-hello-world/zephyr/soc/xlnx/zynq7000/Kconfig.sysbuild"
osource "C:/Users/GameON/sdk/fenix-fx500-hello-world/zephyr/soc/xen/Kconfig.sysbuild"
osource "C:/Users/GameON/sdk/fenix-fx500-hello-world/zephyr/soc/wch/ch32v/Kconfig.sysbuild"
osource "C:/Users/GameON/sdk/fenix-fx500-hello-world/zephyr/soc/ti/simplelink/Kconfig.sysbuild"
osource "C:/Users/GameON/sdk/fenix-fx500-hello-world/zephyr/soc/ti/lm3s6965/Kconfig.sysbuild"
osource "C:/Users/GameON/sdk/fenix-fx500-hello-world/zephyr/soc/ti/k3/Kconfig.sysbuild"
osource "C:/Users/GameON/sdk/fenix-fx500-hello-world/zephyr/soc/telink/tlsr/Kconfig.sysbuild"
osource "C:/Users/GameON/sdk/fenix-fx500-hello-world/zephyr/soc/starfive/jh71xx/Kconfig.sysbuild"
osource "C:/Users/GameON/sdk/fenix-fx500-hello-world/zephyr/soc/st/stm32/Kconfig.sysbuild"
osource "C:/Users/GameON/sdk/fenix-fx500-hello-world/zephyr/soc/snps/qemu_arc/Kconfig.sysbuild"
osource "C:/Users/GameON/sdk/fenix-fx500-hello-world/zephyr/soc/snps/nsim/arc_v/Kconfig.sysbuild"
osource "C:/Users/GameON/sdk/fenix-fx500-hello-world/zephyr/soc/snps/nsim/arc_classic/Kconfig.sysbuild"
osource "C:/Users/GameON/sdk/fenix-fx500-hello-world/zephyr/soc/snps/hsdk4xd/Kconfig.sysbuild"
osource "C:/Users/GameON/sdk/fenix-fx500-hello-world/zephyr/soc/snps/hsdk/Kconfig.sysbuild"
osource "C:/Users/GameON/sdk/fenix-fx500-hello-world/zephyr/soc/snps/emsk/Kconfig.sysbuild"
osource "C:/Users/GameON/sdk/fenix-fx500-hello-world/zephyr/soc/snps/emsdp/Kconfig.sysbuild"
osource "C:/Users/GameON/sdk/fenix-fx500-hello-world/zephyr/soc/snps/arc_iot/Kconfig.sysbuild"
osource "C:/Users/GameON/sdk/fenix-fx500-hello-world/zephyr/soc/silabs/Kconfig.sysbuild"
osource "C:/Users/GameON/sdk/fenix-fx500-hello-world/zephyr/soc/sifive/sifive_freedom/Kconfig.sysbuild"
osource "C:/Users/GameON/sdk/fenix-fx500-hello-world/zephyr/soc/sensry/Kconfig.sysbuild"
osource "C:/Users/GameON/sdk/fenix-fx500-hello-world/zephyr/soc/rockchip/Kconfig.sysbuild"
osource "C:/Users/GameON/sdk/fenix-fx500-hello-world/zephyr/soc/renode/riscv_virtual/Kconfig.sysbuild"
osource "C:/Users/GameON/sdk/fenix-fx500-hello-world/zephyr/soc/renode/cortex_r8_virtual/Kconfig.sysbuild"
osource "C:/Users/GameON/sdk/fenix-fx500-hello-world/zephyr/soc/renesas/smartbond/Kconfig.sysbuild"
osource "C:/Users/GameON/sdk/fenix-fx500-hello-world/zephyr/soc/renesas/rzt2m/Kconfig.sysbuild"
osource "C:/Users/GameON/sdk/fenix-fx500-hello-world/zephyr/soc/renesas/rz/Kconfig.sysbuild"
osource "C:/Users/GameON/sdk/fenix-fx500-hello-world/zephyr/soc/renesas/rcar/Kconfig.sysbuild"
osource "C:/Users/GameON/sdk/fenix-fx500-hello-world/zephyr/soc/renesas/ra/Kconfig.sysbuild"
osource "C:/Users/GameON/sdk/fenix-fx500-hello-world/zephyr/soc/realtek/ec/Kconfig.sysbuild"
osource "C:/Users/GameON/sdk/fenix-fx500-hello-world/zephyr/soc/raspberrypi/rpi_pico/Kconfig.sysbuild"
osource "C:/Users/GameON/sdk/fenix-fx500-hello-world/zephyr/soc/quicklogic/eos_s3/Kconfig.sysbuild"
osource "C:/Users/GameON/sdk/fenix-fx500-hello-world/zephyr/soc/qemu/virt_riscv/Kconfig.sysbuild"
osource "C:/Users/GameON/sdk/fenix-fx500-hello-world/zephyr/soc/qemu/malta/Kconfig.sysbuild"
osource "C:/Users/GameON/sdk/fenix-fx500-hello-world/zephyr/soc/openisa/rv32m1/Kconfig.sysbuild"
osource "C:/Users/GameON/sdk/fenix-fx500-hello-world/zephyr/soc/nxp/s32/Kconfig.sysbuild"
osource "C:/Users/GameON/sdk/fenix-fx500-hello-world/zephyr/soc/nxp/rw/Kconfig.sysbuild"
osource "C:/Users/GameON/sdk/fenix-fx500-hello-world/zephyr/soc/nxp/mcx/Kconfig.sysbuild"
osource "C:/Users/GameON/sdk/fenix-fx500-hello-world/zephyr/soc/nxp/lpc/Kconfig.sysbuild"
osource "C:/Users/GameON/sdk/fenix-fx500-hello-world/zephyr/soc/nxp/layerscape/Kconfig.sysbuild"
osource "C:/Users/GameON/sdk/fenix-fx500-hello-world/zephyr/soc/nxp/kinetis/Kconfig.sysbuild"
osource "C:/Users/GameON/sdk/fenix-fx500-hello-world/zephyr/soc/nxp/imxrt/Kconfig.sysbuild"
osource "C:/Users/GameON/sdk/fenix-fx500-hello-world/zephyr/soc/nxp/imx/Kconfig.sysbuild"
osource "C:/Users/GameON/sdk/fenix-fx500-hello-world/zephyr/soc/nuvoton/numicro/Kconfig.sysbuild"
osource "C:/Users/GameON/sdk/fenix-fx500-hello-world/zephyr/soc/nuvoton/numaker/Kconfig.sysbuild"
osource "C:/Users/GameON/sdk/fenix-fx500-hello-world/zephyr/soc/nuvoton/npcx/Kconfig.sysbuild"
osource "C:/Users/GameON/sdk/fenix-fx500-hello-world/zephyr/soc/nuvoton/npcm/Kconfig.sysbuild"
osource "C:/Users/GameON/sdk/fenix-fx500-hello-world/zephyr/soc/nordic/Kconfig.sysbuild"
osource "C:/Users/GameON/sdk/fenix-fx500-hello-world/zephyr/soc/neorv32/Kconfig.sysbuild"
osource "C:/Users/GameON/sdk/fenix-fx500-hello-world/zephyr/soc/native/inf_clock/Kconfig.sysbuild"
osource "C:/Users/GameON/sdk/fenix-fx500-hello-world/zephyr/soc/microchip/miv/Kconfig.sysbuild"
osource "C:/Users/GameON/sdk/fenix-fx500-hello-world/zephyr/soc/microchip/mec/Kconfig.sysbuild"
osource "C:/Users/GameON/sdk/fenix-fx500-hello-world/zephyr/soc/mediatek/mt8xxx/Kconfig.sysbuild"
osource "C:/Users/GameON/sdk/fenix-fx500-hello-world/zephyr/soc/lowrisc/opentitan/Kconfig.sysbuild"
osource "C:/Users/GameON/sdk/fenix-fx500-hello-world/zephyr/soc/litex/litex_vexriscv/Kconfig.sysbuild"
osource "C:/Users/GameON/sdk/fenix-fx500-hello-world/zephyr/soc/ite/ec/Kconfig.sysbuild"
osource "C:/Users/GameON/sdk/fenix-fx500-hello-world/zephyr/soc/intel/raptor_lake/Kconfig.sysbuild"
osource "C:/Users/GameON/sdk/fenix-fx500-hello-world/zephyr/soc/intel/lakemont/Kconfig.sysbuild"
osource "C:/Users/GameON/sdk/fenix-fx500-hello-world/zephyr/soc/intel/intel_socfpga_std/Kconfig.sysbuild"
osource "C:/Users/GameON/sdk/fenix-fx500-hello-world/zephyr/soc/intel/intel_socfpga/Kconfig.sysbuild"
osource "C:/Users/GameON/sdk/fenix-fx500-hello-world/zephyr/soc/intel/intel_niosv/Kconfig.sysbuild"
osource "C:/Users/GameON/sdk/fenix-fx500-hello-world/zephyr/soc/intel/intel_ish/Kconfig.sysbuild"
osource "C:/Users/GameON/sdk/fenix-fx500-hello-world/zephyr/soc/intel/intel_adsp/Kconfig.sysbuild"
osource "C:/Users/GameON/sdk/fenix-fx500-hello-world/zephyr/soc/intel/elkhart_lake/Kconfig.sysbuild"
osource "C:/Users/GameON/sdk/fenix-fx500-hello-world/zephyr/soc/intel/atom/Kconfig.sysbuild"
osource "C:/Users/GameON/sdk/fenix-fx500-hello-world/zephyr/soc/intel/apollo_lake/Kconfig.sysbuild"
osource "C:/Users/GameON/sdk/fenix-fx500-hello-world/zephyr/soc/intel/alder_lake/Kconfig.sysbuild"
osource "C:/Users/GameON/sdk/fenix-fx500-hello-world/zephyr/soc/infineon/cat3/Kconfig.sysbuild"
osource "C:/Users/GameON/sdk/fenix-fx500-hello-world/zephyr/soc/infineon/cat1b/Kconfig.sysbuild"
osource "C:/Users/GameON/sdk/fenix-fx500-hello-world/zephyr/soc/infineon/cat1a/Kconfig.sysbuild"
osource "C:/Users/GameON/sdk/fenix-fx500-hello-world/zephyr/soc/gd/gd32/Kconfig.sysbuild"
osource "C:/Users/GameON/sdk/fenix-fx500-hello-world/zephyr/soc/gaisler/leon3/Kconfig.sysbuild"
osource "C:/Users/GameON/sdk/fenix-fx500-hello-world/zephyr/soc/gaisler/gr716a/Kconfig.sysbuild"
osource "C:/Users/GameON/sdk/fenix-fx500-hello-world/zephyr/soc/espressif/Kconfig.sysbuild"
osource "C:/Users/GameON/sdk/fenix-fx500-hello-world/zephyr/soc/ene/kb1200/Kconfig.sysbuild"
osource "C:/Users/GameON/sdk/fenix-fx500-hello-world/zephyr/soc/efinix/sapphire/Kconfig.sysbuild"
osource "C:/Users/GameON/sdk/fenix-fx500-hello-world/zephyr/soc/cdns/xtensa_sample_controller/Kconfig.sysbuild"
osource "C:/Users/GameON/sdk/fenix-fx500-hello-world/zephyr/soc/cdns/sample_controller32/Kconfig.sysbuild"
osource "C:/Users/GameON/sdk/fenix-fx500-hello-world/zephyr/soc/cdns/dc233c/Kconfig.sysbuild"
osource "C:/Users/GameON/sdk/fenix-fx500-hello-world/zephyr/soc/brcm/bcmvk/Kconfig.sysbuild"
osource "C:/Users/GameON/sdk/fenix-fx500-hello-world/zephyr/soc/brcm/bcm2712/Kconfig.sysbuild"
osource "C:/Users/GameON/sdk/fenix-fx500-hello-world/zephyr/soc/brcm/bcm2711/Kconfig.sysbuild"
osource "C:/Users/GameON/sdk/fenix-fx500-hello-world/zephyr/soc/atmel/sam0/Kconfig.sysbuild"
osource "C:/Users/GameON/sdk/fenix-fx500-hello-world/zephyr/soc/atmel/sam/Kconfig.sysbuild"
osource "C:/Users/GameON/sdk/fenix-fx500-hello-world/zephyr/soc/aspeed/Kconfig.sysbuild"
osource "C:/Users/GameON/sdk/fenix-fx500-hello-world/zephyr/soc/arm/Kconfig.sysbuild"
osource "C:/Users/GameON/sdk/fenix-fx500-hello-world/zephyr/soc/arm/beetle/Kconfig.sysbuild"
osource "C:/Users/GameON/sdk/fenix-fx500-hello-world/zephyr/soc/antmicro/myra/Kconfig.sysbuild"
osource "C:/Users/GameON/sdk/fenix-fx500-hello-world/zephyr/soc/andestech/Kconfig.sysbuild"
osource "C:/Users/GameON/sdk/fenix-fx500-hello-world/zephyr/soc/amd/acp_6_0/Kconfig.sysbuild"
osource "C:/Users/GameON/sdk/fenix-fx500-hello-world/zephyr/soc/ambiq/Kconfig.sysbuild"
osource "C:/Users/GameON/sdk/fenix-fx500-hello-world/zephyr/soc/altr/zephyr_nios2f/Kconfig.sysbuild"
osource "C:/Users/GameON/sdk/fenix-fx500-hello-world/zephyr/soc/altr/qemu_nios2/Kconfig.sysbuild"
osource "C:/Users/GameON/sdk/fenix-fx500-hello-world/zephyr/soc/adi/max32/Kconfig.sysbuild"
osource "C:/Users/GameON/sdk/fenix-fx500-hello-world/modules/zephyr/soc/nuvoton/m2354/soc/nuvoton/numaker/Kconfig.sysbuild"
```
